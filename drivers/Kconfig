## drivers/radio/Kconfig
```kconfig
menuconfig RADIO
	bool "Radio Drivers"
	help
	  Include radio drivers in system config

if RADIO
rsource "at86rf215/Kconfig"
endif # RADIO
```

## drivers/radio/at86rf215/Kconfig
```kconfig
config AT86RF215
	bool "Atmel AT86RF215 Radio Driver"
	default y
	depends on DT_HAS_MICROCHIP_AT86RF215_ENABLED
	select SPI
	help
	  Atmel AT86RF215 Radio Driver
```

## dts/bindings/radio/microchip,at86rf215.yaml
```yaml
description: |
  Atmel AT86RF215 Driver

compatible: "microchip,at86rf215"

include: spi-device.yaml

properties:
    nrst-gpios:
      type: phandle-array
      required: true
```

## west.yml
```yaml
manifest:
  self:
    path: openht-firmware

  remotes:
    - name: zephyrproject-rtos
      url-base: https://github.com/zephyrproject-rtos

  projects:
    - name: zephyr
      remote: zephyrproject-rtos
      revision: main
      import: true
```
